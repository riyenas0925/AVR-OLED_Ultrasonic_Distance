
	.DEF _distance=R4
	.DEF _edge_mode=R6
	.DEF _avg_cnt=R8
	.DEF _sum=R10
	.DEF _digit_1=R12
_gretting_screen:
	.DB  0x0,0x0,0x0,0x0,0x0,0x0,0x0,0x0
	.DB  0x0,0x0,0x4,0x4,0x4,0xFC,0xFC,0x4
	.DB  0x4,0x4,0x4,0xC,0x18,0xF0,0xF0,0xC0
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	.DB  0x0,0x0,0x0,0x0,0x0,0x0,0x0,0x0
_font_10x16:
	.DB  0x0,0xC0,0xE0,0xF0,0xF0,0x38,0x18,0x88
	.DB  0xF8,0xF0,0xF,0x1F,0x1F,0x13,0x18,0xC
	.DB  0x6,0x3,0x1,0x0,0x0,0x0,0x0,0x80
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	.DB  0x0,0x0,0x3F,0x3F,0x0,0x0,0x3F,0x3F
_font_28x32:
	.DB  0x0,0x0,0x0,0x0,0x0,0x0,0x0,0x80
	.DB  0xE0,0xF0,0x70,0x38,0x18,0x18,0x18,0x18
	.DB  0x38,0x70,0xF0,0xE0,0x80,0x0,0x0,0x0
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	.DB  0x7,0x1,0x0,0x0,0x0,0x0,0x0,0x0
_dot_font:
	.DB  0x0,0x0,0x0,0x0,0x0,0x0,0x80,0x80
	.DB  0x80,0x0,0x0,0x0,0x0,0x0,0x0,0x0
	.DB  0x0,0x0,0x0,0x0,0x0,0x3,0x7,0x7
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	.DB  0x3,0x1,0x0,0x0,0x0,0x0,0x0,0x0

__GLOBAL_INI_TBL:
	.DW  0
_0x42:
