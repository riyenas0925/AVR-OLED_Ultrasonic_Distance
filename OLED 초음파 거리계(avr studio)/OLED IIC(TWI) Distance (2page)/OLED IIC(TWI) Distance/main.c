#define F_CPU 16000000UL
#define __PROG_TYPES_COMPAT__

#include <avr/io.h>
#include <util/delay.h>
#include <avr/pgmspace.h>
#include <avr/interrupt.h>
#define add 0x78

volatile unsigned int count = 0,m = 0, n = 0, cnt = 0, over_cnt = 0, sum = 0;
volatile unsigned int one, two, three, four;

const prog_uchar panel [] = {
	0x00, 0x00, 0x00, 0x00, 0x00, 0x00, 0x00, 0x00, 0x00, 0x00, 0x04, 0x04, 0x04, 0xFC, 0xFC, 0x04,
	0x04, 0x04, 0x04, 0x0C, 0x18, 0xF0, 0xF0, 0xC0, 0x00, 0x04, 0x04, 0x04, 0xFC, 0xFC, 0x04, 0x00,
	0x00, 0x20, 0x78, 0xCC, 0x84, 0x84, 0x84, 0x84, 0x0C, 0x1C, 0x1C, 0x20, 0x00, 0x18, 0x0C, 0x0C,
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	0x61, 0x03, 0x0F, 0x1C, 0x1C, 0x30, 0x60, 0x60, 0x00, 0x00, 0x00, 0x00, 0x00, 0x00, 0x00, 0x00
};

	const prog_uchar back_panel [] = {
	0xF8, 0x0E, 0x02, 0x03, 0x01, 0x01, 0x01, 0x01, 0x01, 0x01, 0x01, 0x01, 0x01, 0x01, 0x01, 0x01,
	0x01, 0x01, 0x01, 0x01, 0x01, 0x01, 0x01, 0x01, 0x01, 0x01, 0x01, 0x01, 0x01, 0x01, 0x01, 0x01,
	0x01, 0x01, 0x01, 0x01, 0x01, 0x01, 0x01, 0x01, 0x01, 0x01, 0x01, 0x01, 0x01, 0x01, 0x01, 0x01,
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	0x80, 0x80, 0x80, 0x80, 0x80, 0x80, 0x80, 0x80, 0x80, 0x80, 0x80, 0x80, 0x80, 0xC0, 0x60, 0x3F
};


const prog_uchar font [][20] = {
	{0x00, 0xC0, 0xE0, 0xF0, 0xF0, 0x38, 0x18, 0x88, 0xF8, 0xF0, 0x0F, 0x1F, 0x1F, 0x13, 0x18, 0x0C, 0x06, 0x03, 0x01, 0x00},
	{0x00, 0x00, 0x00, 0x80, 0xC0, 0xE0, 0xF0, 0XF8, 0X38, 0X18, 0x02, 0x12, 0x1B, 0x1D, 0x1F, 0x0F, 0x03, 0x00, 0x00, 0x00},
	{0x00, 0x00, 0xE0, 0xF0, 0xF0, 0x38, 0x88, 0xF8, 0xF8, 0x70, 0x10, 0x18, 0x0C, 0x1E, 0x1E, 0x1B, 0x19, 0x18, 0x08, 0x00},
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	{0xC0, 0xC0, 0x40, 0x40, 0x80, 0x80, 0x40, 0x40, 0xC0, 0x80, 0x3F, 0x3F, 0x00, 0x00, 0x3F, 0x3F, 0x00, 0x00, 0x3F, 0x3F}
};



void out_num(int k)
{
	one = k % 10;
	two = (k / 10) % 10;
	three = (k / 100) % 10;
	four = k / 1000;
}

void write(uint8_t com)
{
	TWCR=0xA4;	//Send START
	while (!(TWCR & (1<<TWINT)));

	TWDR=add;	//slave address + R/W
	TWCR=0x84;
	while (!(TWCR & (1<<TWINT)));
	
	TWDR=0x00;	//command 모드
	TWCR=0x84;
	while (!(TWCR & (1<<TWINT)));

	TWDR=com;	//data 출력
	TWCR=0x84;
	while (!(TWCR & (1<<TWINT)));

	TWCR=0x94;	//Send STOP
}

void data_write(uint8_t data)
{
	TWCR=0xA4;	//Send START
	while (!(TWCR & (1<<TWINT)));

	TWDR=add;	//slave address + R/W
	TWCR=0x84;
	while (!(TWCR & (1<<TWINT)));
	
	TWDR=0x40;	//data 모드
	TWCR=0x84;
	while (!(TWCR & (1<<TWINT)));

	TWDR=data;	//data 출력
	TWCR=0x84;
	while (!(TWCR & (1<<TWINT)));

	TWCR=0x94;	//Send STOP
}

void draw(const unsigned char *ch)
{
	unsigned char x,y;
	unsigned int i=0;

	for(y=0;y<4;y++)
	{
		write(0xb0+y);
		write(0x00);
		write(0x10);

		for(x=0;x<128;x++)
		{
			data_write(pgm_read_byte(&ch[i++]));
		}
	}
}

void draw_font(int x, int y, int ch)
{
	unsigned int i, j, k =0;
	unsigned int high, low;

	high = x / 16;
	low = x % 16;

	for(i=0; i<2; i++)
	{
		write(0xb0+i+y);
		write(0x00+low);
		write(0x18+high);
		for(j=0; j < 10; j++)
		{
			data_write(pgm_read_byte(&font[ch][k++]));
		}
	}
}

void draw_large_font(int x, int y, int ch)
{
	unsigned int i, j, k =0;
	unsigned int high, low;

	high = x / 16;
	low = x % 16;

	for(i=0; i<4; i++)
	{
		write(0xb0+i+y);
		write(0x00+low);
		write(0x18+high);

		for(j=0; j < 28; j++)
		{
			data_write(pgm_read_byte(&large_font[k++]));
		}
	}
}

void clear(void)
{
	unsigned int i, j;

	for(i=0; i<4; i++)
	{
		write(0xb0+i);
		write(0x00);
		write(0x10);
		for(j=0; j < 128; j++)
		{
			data_write(0x00);
		}
	}
}

void oled_init(void)
{
	write(0xAE);   //display off
	write(0x20); //Set Memory Addressing Mode
	write(0x10); //00,Horizontal Addressing Mode;01,Vertical Addressing Mode;10,Page Addressing Mode (RESET);11,Invalid
	write(0xb0); //Set Page Start Address for Page Addressing Mode,0-7
	write(0xc8); //Set COM Output Scan Direction
	write(0x00);//---set low column address
	write(0x10);//---set high column address
	write(0x40);//--set start line address

	write(0x81);//--set contrast control register*
	write(0xFF);

	write(0xa1);//--set segment re-map 0 to 127
	write(0xa6);//--set normal display
	write(0xa8);//--set multiplex ratio(1 to 64)
	write(0x1F);//
	write(0xa4);//0xa4,Output follows RAM content;0xa5,Output ignores RAM content
	write(0xd3);//-set display offset
	write(0x00);//-not offset
	write(0xd5);//--set display clock divide ratio/oscillator frequency
	write(0xf0);//--set divide ratio
	write(0xd9);//--set pre-charge period

	write(0x22); //
	write(0xda);//--set com pins hardware configuration
	write(0x02);
	write(0xdb);//--set vcomh

	write(0x20);//0x20,0.77xVcc
	write(0x8d);//--set DC-DC enable
	write(0x14);//
	write(0xaf);//--turn on oled panel
}

ISR(TIMER0_OVF_vect)
{
	TCNT0=140;
	count++;
}


ISR(INT0_vect)
{
	if(m == 0)
	{
		count = 0;
		TIMSK=0x01;
		TCCR0=0x02;
		TCNT0=140;
		MCUCR=0x02;
		m = 1;
	}

	else
	{
		TIMSK=0x00;
		m = 0;

		if(count < 450)
		{
			sum = sum + count;
			cnt++;
		}

		if(cnt == 10)
		{
			out_num(sum/cnt);
			cnt=0;
			sum=0;
		}
		MCUCR=0x03;
	}
}

int main(void)
{
	DDRC = 0xFF;
	DDRD = 0x01;

	TWBR = 12;	//(CPU_Clock/SCL_Clock) - 16)/2 = TWBR*(4^TWPS)
	TWSR = 0x00;

	GICR=0x40;
	MCUCR=0x03;
	SREG=0x80;

	oled_init();
	_delay_ms(50);


	draw(panel);
	_delay_ms(1000);

	draw(back_panel);

	clear();
	while(1)
	{
		PORTD=0x01;
		_delay_us(10);
		PORTD=0x00;
		_delay_ms(10);

		draw_font(16,1,four);
		draw_font(32,1,three);
		draw_font(48,1,two);
		draw_font(64,1,one);
		draw_font(86,1,10);
		draw_font(96,1,11);
		_delay_ms(60);
	}
}