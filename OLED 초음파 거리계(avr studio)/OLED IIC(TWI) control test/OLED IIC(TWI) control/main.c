#define F_CPU 16000000UL
#define __PROG_TYPES_COMPAT__

#include <avr/io.h>
#include <util/delay.h>
#include <avr/pgmspace.h>
#define add 0x78


const prog_uchar panel [] = {
	0x00, 0x00, 0x00, 0x00, 0x00, 0x00, 0x00, 0x00, 0x00, 0x00, 0x04, 0x04, 0x04, 0xFC, 0xFC, 0x04,
	0x04, 0x04, 0x04, 0x0C, 0x18, 0xF0, 0xF0, 0xC0, 0x00, 0x04, 0x04, 0x04, 0xFC, 0xFC, 0x04, 0x00,
	0x00, 0x20, 0x78, 0xCC, 0x84, 0x84, 0x84, 0x84, 0x0C, 0x1C, 0x1C, 0x20, 0x00, 0x18, 0x0C, 0x0C,
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	0x61, 0x03, 0x0F, 0x1C, 0x1C, 0x30, 0x60, 0x60, 0x00, 0x00, 0x00, 0x00, 0x00, 0x00, 0x00, 0x00
};

const prog_uchar clear [] = {
	0xF0, 0xF8, 0x3C, 0x0E, 0x07, 0x07, 0x03, 0x03, 0x03, 0x03, 0x03, 0x03, 0x03, 0x03, 0x03, 0x03,
	0x03, 0x03, 0x03, 0x03, 0x03, 0x03, 0x03, 0x03, 0x03, 0x03, 0x03, 0x03, 0x03, 0x03, 0x03, 0x03,
	0x03, 0x03, 0x03, 0x03, 0x03, 0x03, 0x03, 0x03, 0x03, 0x03, 0x03, 0x03, 0x03, 0x03, 0x03, 0x03,
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	0xC1, 0xC0, 0xC0, 0xC1, 0xC1, 0xC1, 0xC1, 0xC1, 0xC1, 0xC0, 0xC0, 0xC0, 0xE0, 0x70, 0x3F, 0x1F
};


void write(uint8_t com)
{
	TWCR=0xA4;	//Send START
	while (!(TWCR & (1<<TWINT)));

	TWDR=add;	//slave address + R/W
	TWCR=0x84;
	while (!(TWCR & (1<<TWINT)));
	
	TWDR=0x00;	//command 모드
	TWCR=0x84;
	while (!(TWCR & (1<<TWINT)));

	TWDR=com;	//data 출력
	TWCR=0x84;
	while (!(TWCR & (1<<TWINT)));

	TWCR=0x94;	//Send STOP
}

void data_write(uint8_t data)
{
	TWCR=0xA4;	//Send START
	while (!(TWCR & (1<<TWINT)));

	TWDR=add;	//slave address + R/W
	TWCR=0x84;
	while (!(TWCR & (1<<TWINT)));
		
	TWDR=0x40;	//data 모드
	TWCR=0x84;
	while (!(TWCR & (1<<TWINT)));

	TWDR=data;	//data 출력
	TWCR=0x84;
	while (!(TWCR & (1<<TWINT)));

	TWCR=0x94;	//Send STOP
}


void draw(const unsigned char *ch)
{
	unsigned char x,y;
	unsigned int i=0;

	for(y=0;y<4;y++)
	{
		write(0xb0+y);
		write(0x00);
		write(0x10);

		for(x=0;x<128;x++)
		{
			data_write(pgm_read_byte(&ch[i++]));
		}
	}
}


void oled_init(void)
{
	write(0xAE);   //display off
	write(0x20); //Set Memory Addressing Mode
	write(0x10); //00,Horizontal Addressing Mode;01,Vertical Addressing Mode;10,Page Addressing Mode (RESET);11,Invalid
	write(0xb0); //Set Page Start Address for Page Addressing Mode,0-7
	write(0xc8); //Set COM Output Scan Direction
	write(0x00);//---set low column address
	write(0x10);//---set high column address
	write(0x40);//--set start line address

	write(0x81);//--set contrast control register*
	write(0xFF);

	write(0xa1);//--set segment re-map 0 to 127
	write(0xa6);//--set normal display
	write(0xa8);//--set multiplex ratio(1 to 64)
	write(0x1F);//
	write(0xa4);//0xa4,Output follows RAM content;0xa5,Output ignores RAM content
	write(0xd3);//-set display offset
	write(0x00);//-not offset
	write(0xd5);//--set display clock divide ratio/oscillator frequency
	write(0xf0);//--set divide ratio
	write(0xd9);//--set pre-charge period

	write(0x22); //
	write(0xda);//--set com pins hardware configuration
	write(0x02);
	write(0xdb);//--set vcomh

	write(0x20);//0x20,0.77xVcc
	write(0x8d);//--set DC-DC enable
	write(0x14);//
	write(0xaf);//--turn on oled panel
}

int main(void)
{
	DDRC = 0xFF;
	TWBR = 12;	//(CPU_Clock/SCL_Clock) - 16)/2 = TWBR*(4^TWPS)
	TWSR = 0x00;

	oled_init();
	_delay_ms(50);

	draw(panel);
	_delay_ms(1000);

	draw(clear);

	while(1)
	{
		draw(panel);
		_delay_ms(50);
	}
}

